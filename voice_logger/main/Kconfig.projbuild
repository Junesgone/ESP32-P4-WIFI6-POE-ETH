## voice_logger/main/Kconfig.projbuild
```kconfig
# SPDX-License-Identifier: Apache-2.0
# Copyright 2026 Junesgone

menu "Voice logger configuration"

    config ESP_WIFI_SSID
        string "Wi-Fi SSID"
        default "myssid"
        help
            SSID of the 2.4 GHz access point.  The on-board ESP32-C6 radio is
            2.4 GHz only, so a 5 GHz-only SSID will never connect.

    config ESP_WIFI_PASSWORD
        string "Wi-Fi password"
        default "mypassword"

    config VOICE_VAD_START_RMS
        int "VAD: RMS threshold to open an utterance"
        default 600
        help
            Raw 16-bit RMS of one 20 ms frame.  Quiet room noise floor sits
            around 30-120; normal speech at arm's length is 600-3000.

    config VOICE_VAD_HANGOVER_MS
        int "VAD: trailing silence that closes an utterance (ms)"
        default 700

    config VOICE_VAD_MIN_SPEECH_MS
        int "VAD: minimum speech length to keep an utterance (ms)"
        default 300

    config VOICE_VAD_MAX_UTTERANCE_MS
        int "VAD: hard cut-off for a single utterance (ms)"
        default 20000

    config VOICE_PREROLL_MS
        int "Audio kept before speech is detected (ms)"
        default 300

    config ASR_API_KEY
        string "ASR API key (empty = reuse the DeepSeek key)"
        default ""
        help
            Key for the speech-to-text endpoint.  Leave it empty and the
            DeepSeek key below is used, which is what the default backend
            (POST /v1/tools/asr) needs.  Filling it in points the same code at
            another vendor.

    config ASR_BASE_URL
        string "ASR endpoint URL"
        default "https://api.deepseek.com/v1/tools/asr"
        help
            DeepSeek standalone Speech-to-Text endpoint: multipart/form-data
            with one "file" field holding a 16-bit PCM WAV (8/16/22.05/24/32/
            44.1/48 kHz, mono or stereo, <= 8 MiB, <= 120 s).  The language is
            auto-detected.  A self-hosted FunASR/Paraformer service can be
            dropped in by pointing this at the LAN box.

    config ASR_MODEL
        string "ASR model name (empty = omit the field)"
        default ""
        help
            Only for OpenAI-compatible /audio/transcriptions backends.  The
            DeepSeek endpoint takes no model field, so this stays empty and the
            multipart body only carries the file.

    config DEEPSEEK_API_KEY
        string "DeepSeek API key"
        default ""
        help
            Key from platform.deepseek.com.  Keep it in a local defaults file
            (config/deepseek.defaults) rather than in the shared source tree.

    config DEEPSEEK_MODEL
        string "DeepSeek model"
        default "deepseek-flash"
        help
            Only deepseek-flash (V4.1-Flash) has the full-suite application
            features: built-in web search, deep thinking search, URL reading,
            file parsing and the safety check.

    # ------------------------------------------------------------------
    # Full-suite endpoints.  All of them live on the same host; the base URL
    # is here so a proxy can be dropped in without touching the sources.
    # ------------------------------------------------------------------
    config DEEPSEEK_SEARCH_URL
        string "Standalone Search API URL"
        default "https://api.deepseek.com/v1/tools/search"

    config DEEPSEEK_FETCH_URL
        string "Standalone Fetch (read URL) API URL"
        default "https://api.deepseek.com/v1/tools/fetch"

    config DEEPSEEK_OCR_URL
        string "Standalone OCR API URL"
        default "https://api.deepseek.com/v1/tools/ocr"

    config DEEPSEEK_FILES_URL
        string "Files API URL"
        default "https://api.deepseek.com/files"

    config DEEPSEEK_TTS_URL
        string "Text-to-Speech API URL (full text POST)"
        default "https://api.deepseek.com/v1/tools/tts"

    config DEEPSEEK_TTS_WS_URL
        string "Text-to-Speech WebSocket URL (streaming synthesis)"
        default "wss://api.deepseek.com/v1/tools/tts"

    # ------------------------------------------------------------------
    # Build-a-Chatbot feature switches.  These are the same parameters the
    # DeepSeek App uses, handled server-side: the board only declares them.
    # ------------------------------------------------------------------
    config DEEPSEEK_THINKING
        bool "Thinking mode (深度思考)"
        default y
        help
            Sends thinking {"type": "enabled"} with reasoning_effort.  With
            the built-in web search tool declared this turns web search into
            deep thinking search: over several reasoning steps the model
            searches, opens pages and checks facts before answering.  Costs a
            few extra seconds before the first word.  Runtime A/B: the serial
            console command "think on|off".

    config DEEPSEEK_REASONING_EFFORT_HIGH
        bool "Thinking effort: high (default)"
        default y
    config DEEPSEEK_REASONING_EFFORT_MAX
        bool "Thinking effort: max"
    config DEEPSEEK_REASONING_EFFORT_LOW
        bool "Thinking effort: low"

    config DEEPSEEK_REASONING_EFFORT
        string
        default "high" if DEEPSEEK_REASONING_EFFORT_HIGH
        default "max" if DEEPSEEK_REASONING_EFFORT_MAX
        default "low" if DEEPSEEK_REASONING_EFFORT_LOW

    config DEEPSEEK_WEB_SEARCH
        bool "Built-in web search tool (deepseek_web_search)"
        default y
        help
            Declares the server-side tool {"type": "deepseek_web_search"}.
            The service runs the search and answers with citations - the board
            does not perform any HTTP request for it.  With thinking enabled
            this is deep thinking search (深度思考搜索); with thinking disabled
            it is classic web search (联网搜索).  Runtime switch: "search on|off".

    config DEEPSEEK_READ_URL
        bool "Built-in URL reading tool (deepseek_read_url)"
        default y
        help
            Declares {"type": "deepseek_read_url"}: when the user message
            contains links the service fetches those pages and answers from
            them.  Runtime switch: "readurl on|off".

    config DEEPSEEK_SAFETY
        bool "Model content safety (safety_check level high)"
        default y
        help
            Basic risk control on the model input and output.  A refusal is
            returned as finish_reason "content_filter" (or the refusal marker
            in the final chunk) and the board answers with a short spoken
            refusal instead of the blocked text.  Enable it whenever the
            device is used by more than its owner.

    config DEEPSEEK_TITLE
        bool "Conversation title (title.enabled)"
        default y
        help
            Asks the service for a short title for the conversation, returned
            in the last stream chunk (delta.title) or message.title.  Sent only
            while the current conversation has no title yet, as the guide
            recommends.  Stored with the turn on the TF card.

    config DEEPSEEK_USER_CITY
        string "User location for the metadata marker"
        default "中国"
        help
            Location field of the latest_reminder message
            "<date>,<weekday>,<location>,<platform>,<language>" that tells the
            model the current date, weekday, city, platform and language.
            The runtime value follows the "city" console command.

    config DEEPSEEK_USER_PLATFORM
        string "Platform field for the metadata marker (App or Web)"
        default "App"

    config DEEPSEEK_USER_LANGUAGE
        string "Language field for the metadata marker"
        default "中文"

    config DEEPSEEK_MAX_TOKENS
        int "Max reply tokens (per inference step)"
        default 900
        help
            The API applies this to each inference step of a round, and with
            thinking enabled the reasoning tokens are included in the output
            count - 400 was cutting answers off with finish_reason "length"
            once 深度思考 was on by default.  Still short: the persona asks for
            1-3 spoken sentences.

    config DEEPSEEK_TEMPERATURE_X100
        int "LLM temperature x100 (higher = more varied phrasing)"
        range 0 200
        default 80
        help
            The spoken persona needs some variation to stop sounding templated;
            0.80 was picked by an A/B of the persona prompt (0.9 drifts into
            formatting quirks, 0.7 stays a bit stiff).  Replies
            are spoken, so this only affects wording, not any control path.

    # The spoken persona lives in main/app_persona.h - it is a multi-line block
    # of style rules with examples, far easier to review as source than as one
    # escaped Kconfig string.

    config VOICE_AEC
        bool "Echo cancellation (ESP-SR AFE, full duplex)"
        default y
        help
            Feeds the microphone plus a playback reference into ESP-SR's AFE so
            the board can hear you while it is speaking.  Needs the esp-sr
            models in the "model" partition (idf.py flash writes them).
            Turn this off to fall back to the plain I2S capture path plus the
            post-TTS suppression window.

    # The AFE's runtime enable_agc/disable_agc ops are NULL in this configuration
    # (and afe_enable_ns() only warns "NS is not initialized"), so AGC/NS can only
    # be switched at compile time; both stay on by default.
    config VOICE_AEC_AGC
        bool "AFE AGC (automatic gain control)"
        default y
        help
            Level-normalises the microphone signal before ASR.  Turning it off
            lowers the input level by ~6-10 dB; the voiceprint uses the pre-AFE
            signal either way.

    config VOICE_AEC_NS
        bool "AFE NS (WebRTC noise suppression)"
        default y
        help
            Spectral denoising for the ASR uplink.  Kept on by default: it helps
            recognition and the voiceprint does not use the AFE output.

    config VOICE_BLE
        bool "Bluetooth (BLE) via the on-board ESP32-C6"
        default n
        help
            Puts the P4's NimBLE host on top of the C6's BT controller over VHCI.
            OFF by default on purpose: the C6 firmware currently flashed on this
            board does not answer HCI Reset (vhci_drv comes up "Enabled" but
            every command times out with BLE_HS_ETIMEOUT_HCI), so enabling this
            only produces a console full of errors.  Rebuild and re-flash the C6
            slave with CONFIG_ESP_HOSTED_CP_BT=y, then turn this on.

    config VOICE_SPEAKER_THRESHOLD
        int "Voiceprint accept threshold (cosine x100)"
        range 0 100
        default 48
        help
            Cosine similarity (x100) above which an utterance is accepted into
            the closest existing role.  The embedding is computed from the
            pre-AFE microphone signal, standardised with device-fitted tables
            and discriminatively weighted per dimension.  48 (with margin 10)
            is high enough to keep several similar same-gender voices from
            collapsing into one anonymous role; lower values merge speakers
            more eagerly.
            Roles that do not match go through a 2-hit pending buffer before
            人N is created; explicitly enrolled people are never modified.
            The board logs every score and the top1-top2 gap, so this can be
            tuned from real recordings.

    config VOICE_VP_INPUT_RAW
        bool "Voiceprint uses the pre-AFE microphone signal"
        default y
        help
            Compute the speaker embedding from the raw microphone block that is
            captured in parallel with the AFE output.  AEC/NS/AGC reshape the
            spectrum and flatten speaker timbre on the processed signal; ASR
            still uses the AFE output.  Turn this off to use the AFE signal.

    config VOICE_SPEAKER_MARGIN_X100
        int "Voiceprint relative margin gate (cosine x100, 0 = off)"
        range 0 100
        default 10
        help
            A match must beat the runner-up role by at least this much, in
            addition to passing CONFIG_VOICE_SPEAKER_THRESHOLD.  Different
            speakers can both clear an absolute threshold, so the top1-top2 gap
            is the last line of defence.  0 disables the gate.  Tune from the
            "gap" value the board prints on every match.  The serial command
            "vpmargin <x100>" overrides it at runtime for A/B tests.

    config VOICE_ENROLL_SENTENCES
        int "Voiceprint enrollment: utterances averaged per person"
        range 1 8
        default 3
        help
            "enroll <name>" collects this many utterances and saves their
            average embedding (L2-normalised).  Averaging cuts within-speaker
            variance: 3 is a good balance between accuracy and patience, 1
            reproduces the old single-shot behaviour.  The console prints the
            progress after every utterance; "enroll cancel" aborts.

    config VOICE_SPEAKER_VOLUME
        int "Speaker volume (0-100)"
        range 0 100
        default 90
        help
            ES8311 DAC volume.  Measured on this board: 100 clips and breaks up,
            90 is loud and still clean.  Can also be changed at runtime by the
            set_volume tool when you ask 小新 to do it.

    config VOICE_PLAYBACK
        bool "Play each captured utterance back through the speaker"
        default n
        help
            Bring-up utility: plays the captured utterance back through the
            codec/amplifier path.  Off by default.

    # ---------------------------------------------------------------------
    # Cloud neural TTS.  DeepSeek's standalone Text-to-Speech API replaces the
    # old SiliconFlow CosyVoice2 path: 24 kHz mono PCM, two voices (stella /
    # tide), streamed over WebSocket while the text is still being sent.
    # The on-board ESP-SR engine stays as the offline fallback.
    # ---------------------------------------------------------------------
    config VOICE_TTS_CLOUD
        bool "Cloud neural TTS (DeepSeek)"
        default y
        help
            When Wi-Fi is up, synthesize each reply with the DeepSeek neural
            voice instead of the on-board ESP-SR engine.  Any failure (no
            network, timeout, bad key, content filter) silently falls back to
            ESP-SR, so the assistant keeps talking offline.  Runtime A/B: the
            serial console command "tts local" / "tts cloud" / "tts auto".

    config VOICE_TTS_STREAM
        bool "Stream cloud TTS audio while it is generated"
        default y
        help
            Play each PCM block as it arrives instead of waiting for the whole
            reply to be synthesized, so the first word comes out ~1 s sooner.
            Turn this off to use the batch request.

    config VOICE_TTS_WS
        bool "Use the WebSocket streaming TTS protocol (experimental)"
        default n
        help
            Connect to wss://api.deepseek.com/v1/tools/tts, send the reply text
            as {"event":"text"} messages followed by {"event":"finish_text"},
            and play the binary PCM frames as they arrive.  The server sends
            raw 16-bit mono PCM at 24 kHz; the board resamples to 16 kHz for the
            ES8311 path.

            OFF by default: measured on this board the WebSocket path gives no
            latency advantage over the streaming POST (the service sends no
            audio before finish_text on either transport), and the
            esp_websocket_client handshake still fails intermittently
            (esp_transport_read -135 / connect timeout) while its TLS session
            fits worse in the internal RAM.  The streaming POST with
            format=pcm is the default and works.  When this is enabled the
            firmware tries WebSocket first and falls back to POST after a
            failed attempt (with a 5 minute backoff after two failures).

    config TTS_API_KEY
        string "TTS API key (empty = reuse the DeepSeek key)"
        default ""

    config TTS_VOICE_STELLA
        bool "Voice: stella (female)"
        default y
    config TTS_VOICE_TIDE
        bool "Voice: tide (male)"

    config TTS_VOICE_ID
        string
        default "stella" if TTS_VOICE_STELLA
        default "tide" if TTS_VOICE_TIDE

    config TTS_MAX_SECONDS
        int "Longest single synthesized reply (seconds)"
        range 5 60
        default 30
        help
            Ring-buffer / download cap for one cloud reply; the persona prompt
            keeps replies to a couple of sentences, so this is only a safety
            net.  The API itself allows up to 30 minutes per request.

    config TTS_PREBUFFER_MS
        int "Playback prebuffer before the first word (ms)"
        range 0 3000
        default 700
        help
            How much audio to collect before starting playback.  The WebSocket
            stream delivers small frames at a fairly even rate, so a short
            prebuffer is enough; raise it on a congested Wi-Fi link.


    # Boot-time conversation behaviour.  ASSISTANT answers every utterance (the
    # original behaviour: no wake word, just talk to it).  MONITOR never
    # answers, only records and lets the fact-checking supervisor interject.
    # HYBRID answers only when the utterance is addressed ("小新", a question,
    # or a request phrase) and otherwise just records - nice for a room where
    # people talk to each other, but easy to mistake for "it stopped working".
    config VOICE_DEFAULT_MODE
        int "Conversation mode at boot (0=assistant, 1=monitor, 2=hybrid)"
        range 0 2
        default 0
        help
            Runtime switch: serial command "mode assistant|monitor|hybrid".
            ASSISTANT (default) answers every utterance and still lets the
            fact-checking supervisor chip in after the reply; HYBRID answers
            only when addressed and lets the supervisor do the talking
            otherwise; MONITOR never answers.  Runtime switch command: "mode".

    config VOICE_SUPERVISOR
        bool "Proactive fact-checking interjections (主动插话)"
        default y
        help
            While the board is idle, show the rolling transcript to the model
            and let it interrupt with one short correction when a claim
            (weather, price, date, number, ...) is wrong or an important
            omission matters.  It only runs after a reply turn has finished
            (never while the answer is being produced or played), only for
            utterances that contain something checkable, and it sees the
            board's own last answer so it does not repeat it.  Runtime switch:
            serial command "supervisor on|off".

endmenu
```
